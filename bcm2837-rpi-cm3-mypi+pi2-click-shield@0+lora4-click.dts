/* SPDX-License-Identifier: GPL-2.0-or-later OR MIT */
/*
 * Copyright (c) 2019 Andreas Färber
 */

/dts-v1/;
/plugin/;

/ {
	#address-cells = <1>;
	#size-cells = <0>;

	fragment@0 {
		reg = <0>;

		target = <&uart0>;

		__overlay__ {
			status = "okay";

			lora {
				compatible = "mipot,32001353";
				reset-gpios = <&gpio 5 0>;
				wake-gpios = <&gpio 8 0>;
			};
		};
	};
};
