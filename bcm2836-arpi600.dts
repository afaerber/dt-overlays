/*
 * Copyright (c) 2017 Andreas Färber
 *
 * SPDX-License-Identifier: GPL-2.0+ or MIT
 */

/dts-v1/;
/plugin/;

/ {
	compatible = "brcm,bcm2836";

	#address-cells = <1>;
	#size-cells = <0>;

	fragment@0 {
		reg = <0>;

		target-path = "/soc/i2c@7e804000";

		__overlay__ {
			status = "okay";

			#address-cells = <1>;
			#size-cells = <0>;

			rtc@51 {
				compatible = "nxp,pcf8563";
				reg = <0x51>;
				#clock-cells = <0>;
				clock-output-names = "arpi600-pcf8563-clkout";
			};
		};
	};
};
