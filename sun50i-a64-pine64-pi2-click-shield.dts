/*
 * Copyright (c) 2017 Andreas Färber
 *
 * SPDX-License-Identifier: GPL-2.0+ OR MIT
 */

/dts-v1/;
/plugin/;

/ {
	#address-cells = <1>;
	#size-cells = <0>;

	fragment@0 {
		reg = <0>;

		target = <&pio>;

		__overlay__ {
			uart2_pins: uart2-pins {
				pins = "PB0", "PB1";
				function = "uart2";
			};
		};
	};

	fragment@1 {
		reg = <1>;

		target = <&uart2>;

		__overlay__ {
			status = "okay";
			pinctrl-names = "default";
			pinctrl-0 = <&uart2_pins>;
		};
	};
};
